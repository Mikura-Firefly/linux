## arch/loongarch/configs/loongson_soc_defconfig
```kconfig
CONFIG_LOONGARCH=y
CONFIG_32BIT=y
CONFIG_32BIT_REDUCED=y
# CONFIG_EFI is not set
# CONFIG_ACPI is not set
# CONFIG_CPU_HAS_FPU is not set
CONFIG_MACH_LOONGSON32=y
CONFIG_4KB_2LEVEL=y
CONFIG_HZ_100=y
CONFIG_BLK_DEV_INITRD=y
CONFIG_INITRAMFS_SOURCE=""
CONFIG_CMDLINE="earlycon=uart8250,mmio,0x1fe00000,115200,33000000 console=ttyS0,115200"
CONFIG_CMDLINE_FORCE=y
CONFIG_OF=y
CONFIG_OF_EARLY_FLATTREE=y
CONFIG_BUILTIN_DTB=y
CONFIG_BUILTIN_DTB_NAME="loongson-soc"
CONFIG_SERIAL_8250=y
CONFIG_SERIAL_8250_CONSOLE=y
CONFIG_SERIAL_8250_NR_UARTS=1
CONFIG_SERIAL_8250_RUNTIME_UARTS=1
CONFIG_SERIAL_OF_PLATFORM=y
CONFIG_SERIAL_EARLYCON=y
CONFIG_NET=y
CONFIG_PACKET=y
CONFIG_UNIX=y
CONFIG_INET=y
CONFIG_NETDEVICES=y
# CONFIG_PNP is not set
# CONFIG_SERIO is not set
# CONFIG_INPUT is not set
# CONFIG_SUSPEND is not set
CONFIG_DEVTMPFS=y
CONFIG_DEVTMPFS_MOUNT=y
CONFIG_TMPFS=y
CONFIG_PROC_FS=y
CONFIG_SYSFS=y
CONFIG_BINFMT_ELF=y
CONFIG_PRINTK_TIME=y
CONFIG_DEBUG_INFO_NONE=y
CONFIG_DMFE_MAC=y

CONFIG_FB=y
CONFIG_FB_LOONGSON_SOC_VGA=y
CONFIG_FRAMEBUFFER_CONSOLE=y
CONFIG_LOGO=y
```
